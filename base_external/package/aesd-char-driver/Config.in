## base_external/package/aesd-char-driver/Config.in
```kconfig
config BR2_PACKAGE_AESD_CHAR_DRIVER
    tristate "aesd-char-driver"
    depends on BR2_LINUX_KERNEL
    help
      Builds and installs the aesdchar kernel module.
```

## base_external/package/ldd/Config.in
```kconfig
config BR2_PACKAGE_LDD
    bool "ldd"
    help
      Linux Device Drivers 3 kernel modules (scull, misc-modules, faulty)
```
